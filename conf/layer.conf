## conf/layer.conf
```bitbake
# We have a conf and classes directory, add to BBPATH
BBPATH .= ":${LAYERDIR}"

# We have recipes-* directories, add to BBFILES
BBFILES += "${LAYERDIR}/recipes-*/*/*.bb \
            ${LAYERDIR}/recipes-*/*/*.bbappend"

BBFILE_COLLECTIONS += "meta-jaden"
BBFILE_PATTERN_meta-jaden = "^${LAYERDIR}/"
BBFILE_PRIORITY_meta-jaden = "11"

LAYERDEPENDS_meta-jaden = "core"
LAYERSERIES_COMPAT_meta-jaden = "kirkstone"
```
